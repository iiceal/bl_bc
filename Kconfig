## Kconfig
```kconfig
#
# For a description of the syntax of this configuration file,
# see the file Documentation/kbuild/kconfig-language.txt in the
# Linux kernel source tree.
#

mainmenu "HG-BOOTLOADER $HG_BL_VERSION Configuration"

config HG_BL_VERSION
	string
	option env="HG_BL_VERSION"

#menu Board select
source "boards/Kconfig"

# Allow defaults in arch-specific code to override any given here
# Project
source "chip/Kconfig"

source "copy_bl/Kconfig"

#menu "Target CPU Variant"
source "cpu/Kconfig"

#menu "boot parameter"
source "boot/Kconfig"

#menu "General setup"
source "common/Kconfig"

#menu "Drivers"
source "drivers/Kconfig"

#menu "File systems"
source fs/Kconfig

source net/Kconfig

#menu "Command select"
source cmd/Kconfig
```

## boards/Kconfig
```kconfig
choice
	prompt "Board select"
	default BP2016_EVK 
	help
	  Select which Board do you want to build 

config BP2016_EVK 
	bool "BP2016 EVK"

config BP2016_FPGA_DEF
	bool "BP2016 FPGA default"

config BP2016_OEM
	bool "BP2016 OEM"

endchoice

if BP2016_EVK

config BOARD_NAME
    string
    default "bp2016_evk"

endif

if BP2016_FPGA_DEF

config BOARD_NAME
    string
    default "bp2016_fpga_def"

endif


if BP2016_OEM
config BOARD_NAME
    string
    default "oem"
endif
```

## boot/Kconfig
```kconfig
menu "boot parameter"

config DBG_SERIAL_NUM
	int	"debug serial port number for printf"
	range 0  7
	default 0
	help
        This is debug serial port number, the vailid port number is 0~7

endmenu
```

## chip/Kconfig
```kconfig
#
# For a description of the syntax of this configuration file,
# see scripts/kbuild/config-language.txt.
#

choice
	prompt "Project"
	default HG_PROJECT_BP2016 
	help
	  Specific project to use

config HG_PROJECT_BP2016
	bool "BP2016"
	select CPU_V7

endchoice

if HG_PROJECT_BP2016

menu "Chip option"

config HG_PROJECT_NAME
   string 
   default "bp2016"

config SRAM_BL_START
    hex "Bootloader run start address"
	default 0x290000
    help
        config bl boot address

config USE_IRQ
    bool "enable gic"
    default y
    help
    	enable gic driver.

config MMU_ENABLE
    bool "enable mmu"
    default y
    help
    	enable mmu.

config SYS_MALLOC_CLEAR_ON_INIT
    depends on COMMON_MALLOC
	bool "Init with zeros the memory reserved for malloc (slow)"
	default y
	help
	  This setting is enabled by default. The reserved malloc
	  memory is initialized with zeros, so first malloc calls
	  will return the pointer to the zeroed memory. But this
	  slows the boot time.

	  It is recommended to disable it, when CONFIG_SYS_MALLOC_LEN
	  value, has more than few MiB, e.g. when uses bzip2 or bmp logo.
	  Then the boot time can be significantly reduced.
	  Warning:
	  When disabling this, please check if malloc calls, maybe
	  should be replaced by calloc - if one expects zeroed memory.

config MALLOC_LEN_KB 
    depends on COMMON_MALLOC
	int	"malloc address space size"
	range 48  256
	default 64
	help
        Alloc malloc space size, if the size too small, it will lead to malloc failed
        so if some malloc failed, you can change this value

config SYS_MALLOC_DEBUG
    depends on COMMON_MALLOC
	bool "malloc debug interface for stats memory usage"
	default y
	help
        Statistics on current memory usage

config BB_MMU_ENABLE
    bool "enable BB mmu"
    default n 
    select MMU_ENABLE
    help
    	enable BB mmu.
endmenu

endif
```

## cmd/Kconfig
```kconfig
menu "Command select"
    depends on CMD_SHELL

config CMD_JFFS2
	bool "jffs2 command"
    default n
	select FS_JFFS2
    select CMD_FLASH
	help
	  Enables commands to support the JFFS2 (Journalling Flash File System
	  version 2) filesystem. This enables fsload, ls and fsinfo which
	  provide the ability to load files, list directories and obtain
	  filesystem information.


config CMD_FLASH
	bool "Qspi Command"
	default n
    select DRV_QSPI
	help
	  NOR flash Command support, eg: qspi init/read/ahbread ...

config CMD_SPI
	bool "spi Command"
	default n
    select DRV_SPI
	help
	  spi Command support, eg: spi init/read/write...

config CMD_I2C
	bool "i2c Command"
	default n
    select DRV_I2C
	help
	  i2c Command support, eg: i2c init/read/write...

config CMD_MBR
	bool "MBR Command"
	default n
    select DRV_QSPI 
    select DRV_UART
	help
	   MBR Command support, eg:MBR  dump/modify...

config CMD_UPDATE
	bool "update Command"
	default n
    select DRV_QSPI 
    select DRV_UART
	help
	   update Command support, eg:update  flash file...

config CMD_SIM
	bool "sim Command"
	default n
    select DRV_SIM
	help
	  sim Command support, eg: sim init/atr/check...

config CMD_RESET
	bool "reset Command"
	default n
    select DRV_RESET
	help
	  reset Command support, eg: reset qspi/i2c0/spi0 ...

config CMD_WDT
    bool "watchdog Command"
    default y
    select DRV_WDT
    help
		Watchdog driver

config CMD_IOMUX
	bool "iomux Command"
	default n
    select DRV_IOMUX
	help
	  iomux Command support, eg: iomux qspi/i2c0/spi0 ...

config CMD_CLK
	bool "clock get/set Command"
	default n
    select DRV_CLK
	help
	  clock get/set Command support, eg: clk get qspi/i2c0/spi0...

config CMD_ASRAM
	bool "asram test Command"
	default n
    select DRV_ASRAM
	help
	  asram test Command, eg: asram init/auto/rw ...

config CMD_CPU_RIGHT
	bool "cpu right test Command"
	default n
    select DRV_CPU_RIGHT
	help
	  cpu right test Command, eg: right ...

config CMD_GPIO
	bool "gpio test Command"
	default n
    select DRV_GPIO
	help
	  gpio test Command, eg: gpio...

config CMD_UART
	bool "uart test Command"
	default n
    select DRV_UART
	help
	  uart test Command, eg: uart...

config CMD_DMA
	bool "dma test Command"
	default n
    select DRV_DMA
	help
	  dma test Command, eg: dma...

config CMD_DDR
	bool "ddr test Command"
	default n
    select DRV_DDR
	help
	  ddr test Command, eg: ddr...

config CMD_SD
	bool "sd test Command"
	default n
    select DRV_SD
	help
	  sd test Command, eg: sd...

config CMD_NET
	bool "net test Command"
	default n
    select NET
	help
	  net test Command, eg: ping, tftp...

config CMD_GO
	bool "go and run Command"
	default y
	help
	  go to addr running...

endmenu
```

## common/Kconfig
```kconfig
menu "General setup"

config FASTBOOT
    bool "enable fast boot function"
    default n
    help
        fast boot support.

config COMMON_MALLOC
    bool "enable common dlmalloc"
    default n
    help
        common malloc and free function.

config CMD_SHELL
    bool "enable cmd shell"
    default n
    select DRV_UART
    select COMMON_MALLOC
    help
        cmd shell in uart0.

config UPV_SERIAl
    bool "enable upgrade for uart"
    default n
    select UPV_QSPI
    select DRV_UART
    help
        Upgrade bootloader form uart.

config UPV_SERIAL_NUM
	int	"upgrade serial port number"
	range 0  7
	default 1
    depends on UPV_SERIAl
	help
        This is upgrade serial port number, the vailid port number is 0~7.
        Attention: this number must different of CONFIG_DBG_SERIAL_NUM
config UPV_SERIAL_BAUDRATE
	int	"upgrade serial port number"
	range 9600  921600
	default 921600
    depends on UPV_SERIAl
	help
        This is upgrade serial port baudrate, the vailid port number is 9600~921600.

config UPV_QSPI
    bool "qspi upgrade"
    default n
    select DRV_QSPI
    select QSPI_DMA_TRANSFER
    select DRV_DMA
    help
        qspi upgrade version

config BUILD_ENABLE_UNWIND
    bool "enable unwind dump stack debug function"
	default n
    help
    Unwind is a debug way provided by libgcc.
    enable this function we can get call stack when rise exception,
	or we can call this function for dump call stack which we want.

config ENABLE_GCC_SAVE_TEMPS
    bool "enable -save-temps for gcc"
    default n
    help
        optional gcc compile paramters, for save *.i *.s temporary files
    
config DEBUG_INFO
    bool "debug info enable"
    default y
    help
    	enable gcc -g -gdwarf-2.

config LOAD_XMODEM
    bool "enable load xmodem"
    default y
    help
    	enable xmodem

config BOOT_COUNT_DOWN
    bool "count down for start"
    default y
#    depends on CMD_SHELL
#    select UPV_QSPI
#    select DRV_UART
#    select CMD_UART
    help
        count down for startting bl shell.

config BOOT_COUNT_DOWN_SEC
	int	"boot count down seconds"
	range 0  15
	default 3
    depends on BOOT_COUNT_DOWN
	help
        counting down for breaking auto boot, the vailid time is 0~5s.
        Attention: if set 0, meaning bypass...

config AUTO_UPGRADE
    bool "auto upgrade in boot sequence"
    default n
    select UPV_QSPI
    select DRV_UART
    help
        auto upgrade in booting...

config AUTO_UPGRADE_DELAY_MS
	int	"waiting time for upgrade in bl"
	range 0  1500
	default 100
    depends on AUTO_UPGRADE
	help
        waitting upgrade flag in booting sequence, the vailid time is 0~500ms.
        Attention: if set 0, meaning bypass...
                   less than 100, can not assure enter auto upgrade procedure.

config ENABLE_TRACE
	bool "enable print trace"
	default n
	help
        Attention: if enable, print message for bootloader, or only keep printf bl version message
endmenu
```

## copy_bl/Kconfig
```kconfig
config COPY_BL_TO_BL_START
    bool "copy Bootloader to SRAM_BL_START"
    default n
    help
       copy Bootloader to SRAM_BL_START, Attention, if you select this
       config, we not compile Bootloader but the code copy Bootloader
       to its run address
```

## cpu/Kconfig
```kconfig
#
# For a description of the syntax of this configuration file,
# see scripts/kbuild/config-language.txt.
#

config CPU_V7
    bool

if CPU_V7 

config CPU_NAME 
    string
    default "armv7"

menu "Target CPU Variant"

config HG_ARCH_ARM_CORTEX_A7
	bool "maybe define later"

endmenu #prompt "Target Architecture Variant"

endif #HG_ARCH_ARM
```

## drivers/Kconfig
```kconfig
menu "Drivers"

source drivers/qspi/Kconfig
source drivers/sim/Kconfig
source drivers/i2c/Kconfig
source drivers/spi/Kconfig
source drivers/dma/Kconfig
source drivers/uart/Kconfig
source drivers/reset/Kconfig
source drivers/wdt/Kconfig
source drivers/iomux/Kconfig
source drivers/clk/Kconfig
source drivers/cpu_right/Kconfig
source drivers/gpio/Kconfig
source drivers/ddr/Kconfig
source drivers/sd/Kconfig
source drivers/net/Kconfig

endmenu
```

## drivers/clk/Kconfig
```kconfig
config DRV_CLK
    bool "enable clock function"
    default n
    depends on HG_PROJECT_BP2016
    help
		module clock get/set function
```

## drivers/cpu_right/Kconfig
```kconfig
config DRV_CPU_RIGHT
    bool "enable cpu right function"
    default n
    help
		cpu right module function
```

## drivers/ddr/Kconfig
```kconfig
menuconfig  DRV_DDR
	bool "enable DDR driver"
    default n
    select DRV_CLK
    select DRV_RESET
    ---help---
        ddr controller driver

if DRV_DDR

choice
	prompt "DDR type select"
	default LPDDR 
	help
	  Select DDR type to init  

config LPDDR 
	bool "LPDDR chip"
    depends on !BP2016_FPGA_DEF

config LPDDR2
	bool "LPDDR2 chip"
    depends on !BP2016_FPGA_DEF

config DDR3
	bool "DDR3 chip"
    depends on !BP2016_FPGA_DEF

config DDR_FPGA
	bool "DDR in BP2016 FPGA"
    depends on BP2016_FPGA_DEF

endchoice

endif
```

## drivers/dma/Kconfig
```kconfig
config DRV_DMA 
    bool "enable dma driver"
    default n
    help
		dma driver
```

## drivers/gpio/Kconfig
```kconfig
config DRV_GPIO
    bool "enable gpio driver"
    default n
    help
		gpio driver
```

## drivers/i2c/Kconfig
```kconfig
config DRV_I2C 
    bool "enable i2c driver"
    default n
    help
		i2c driver
```

## drivers/iomux/Kconfig
```kconfig
config DRV_IOMUX
    bool "enable iomux function"
    default n
    depends on HG_PROJECT_BP2016
    help
		module iomux function
```

## drivers/net/Kconfig
```kconfig
#
# network device configuration
#

menuconfig DRV_NET
	bool "enable net driver"
	default n
	depends on DRV_SPI
	---help---
	  net driver

if DRV_NET
config MACADDR
    string      "mac address"
    default     "f4:8e:38:a4:e7:7d"
    help
        board mac address
config IPADDR
    string      "ip address"
    default     "192.168.1.122"
    help
        board default static ip address
endif #DRV_NET
```

## drivers/qspi/Kconfig
```kconfig
menuconfig  DRV_QSPI
	bool "QSPI driver"
    default n
    ---help---
        qspi controller driver

if DRV_QSPI

config QSPI_DMA_TRANSFER
	bool "enable qspi dma read/write"
    default n
	depends on DRV_DMA
    ---help---
	help
		enable qspi dma transfer 

config QSPI_S25FL512S
	bool "enable s25fl512s driver"
    default n
    ---help---
		enable s25fl512s driver

config QSPI_W25Q256FV
    bool "enable w25q256fv driver"
    default n
    ---help---
		enable w25q256fv driver
    
config QSPI_GD25Q512MC
    bool "enable gd25q512mc driver"
    default n
    ---help---
		enable gd25q512mc driver

config QSPI_GD25Q256D
    bool "enable gd25q256d driver"
    default y
    ---help---
		enable gd25q256d driver

endif
```

## drivers/reset/Kconfig
```kconfig
config DRV_RESET
    bool "enable reset function"
    default n
    depends on HG_PROJECT_BP2016
    help
		module reset function
```

## drivers/spi/Kconfig
```kconfig
menuconfig DRV_SPI
    bool "enable spi driver"
    default n
    help
		SPI driver

if DRV_SPI

if DRV_NET
config W5500_SPI_BUS
    int "w5500 spi bus index"
    range 0 2
    default 0
    help
        this indicates w5500 phy use which spi bus

config W5500_SPI_CS
    int "w5500 spi bus cs"
    range 0 8
    default 0
    help
        this indecates w5500 phy use spi bus which cs
endif #DRV_NET

endif #DRV_SPI
```
